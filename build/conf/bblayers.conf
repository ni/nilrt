## build/conf/bblayers.conf
```bitbake
LCONF_VERSION = "5"

BBPATH = "${TOPDIR}"

BBFILES = ""

BBLAYERS ?= " \
    ${TOPDIR}/../sources/openembedded-core/meta \
    ${TOPDIR}/../sources/meta-openembedded/meta-oe \
    ${TOPDIR}/../sources/meta-openembedded/meta-filesystems \
    ${TOPDIR}/../sources/meta-openembedded/meta-gnome \
    ${TOPDIR}/../sources/meta-openembedded/meta-multimedia \
    ${TOPDIR}/../sources/meta-openembedded/meta-networking \
    ${TOPDIR}/../sources/meta-openembedded/meta-perl \
    ${TOPDIR}/../sources/meta-openembedded/meta-python \
    ${TOPDIR}/../sources/meta-openembedded/meta-ruby \
    ${TOPDIR}/../sources/meta-openembedded/meta-webserver \
    ${TOPDIR}/../sources/meta-openembedded/meta-xfce \
    ${TOPDIR}/../sources/meta-openembedded/meta-initramfs \
    ${TOPDIR}/../sources/meta-mingw \
    ${TOPDIR}/../sources/meta-nilrt \
    ${TOPDIR}/../sources/meta-selinux \
    ${TOPDIR}/../sources/meta-cloud-services/meta-openstack \
    ${TOPDIR}/../sources/meta-cloud-services \
    ${TOPDIR}/../sources/meta-mono \
    ${TOPDIR}/../sources/meta-virtualization \
    ${TOPDIR}/../sources/meta-security \
    ${TOPDIR}/../sources/meta-orgconf \
    ${TOPDIR}/../sources/meta-sdr \
    ${TOPDIR}/../sources/meta-java \
    ${TOPDIR}/../sources/meta-measured \
    ${TOPDIR}/../sources/meta-qt4 \
    "

BBLAYERS_NON_REMOVABLE ?= " \
    ${TOPDIR}/../sources/openembedded-core/meta \
    "
```

## conf/bblayers.conf
```bitbake
LCONF_VERSION = "5"

BBPATH = "${TOPDIR}"

BBFILES = ""

BB_MONO_LAYERS ?= " \
    ${TOPDIR}/sources/meta-mono \
    "

BBLAYERS_EXTRAS ?= " \
    ${BB_MONO_LAYERS} \
    "

BBLAYERS ?= " \
    ${TOPDIR}/sources/openembedded-core/meta \
    ${TOPDIR}/sources/meta-openembedded/meta-oe \
    ${TOPDIR}/sources/meta-openembedded/meta-xfce \
    ${TOPDIR}/sources/meta-openembedded/meta-gnome \
    ${TOPDIR}/sources/meta-openembedded/meta-networking \
    ${TOPDIR}/sources/meta-nilrt \
    ${BBLAYERS_EXTRAS} \
    "

BBLAYERS_NON_REMOVABLE ?= " \
    ${TOPDIR}/sources/openembedded-core/meta \
    "
```
